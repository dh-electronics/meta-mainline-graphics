## conf/layer.conf
```bitbake
# We have a conf and classes directory, add to BBPATH
BBPATH .= ":${LAYERDIR}"

# We have a packages directory, add to BBFILES
BBFILES += "${LAYERDIR}/recipes-*/*/*.bb"
BBFILES += "${LAYERDIR}/recipes-*/*/*.bbappend"

BBFILE_COLLECTIONS += "mainlinegraphics-layer"
BBFILE_PATTERN_mainlinegraphics-layer = "^${LAYERDIR}/"
BBFILE_PRIORITY_mainlinegraphics-layer = "5"

LAYERDEPENDS_mainlinegraphics-layer = "core"
LAYERSERIES_COMPAT_mainlinegraphics-layer = "zeus dunfell"

BBFILES_DYNAMIC += " \
	openembedded-layer:${LAYERDIR}/dynamic-layers/openembedded-layer/*/*/*.bb \
	openembedded-layer:${LAYERDIR}/dynamic-layers/openembedded-layer/*/*/*.bbappend \
	"
```
